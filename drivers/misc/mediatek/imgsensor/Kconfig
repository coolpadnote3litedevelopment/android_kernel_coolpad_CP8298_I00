## drivers/misc/mediatek/imgsensor/Kconfig
```kconfig
config MTK_IMGSENSOR
  bool CONFIG_MTK_IMGSENSOR
  default n
  help
    CONFIG_MTK_IMGSENSOR

config MTK_EFUSE_DOWNGRADE
  bool "CONFIG_MTK_EFUSE_DOWNGRADE"
  default n
  help
    CONFIG_MTK_EFUSE_DOWNGRADE

config YL_CAM_MODULE_NAME
  bool CONFIG_YL_CAM_MODULE_NAME
  default n
  help
    CONFIG_YL_CAM_MODULE_NAME
```
